#include <behaviors.dtsi>
#include <dt-bindings/zmk/bt.h>
#include <dt-bindings/zmk/ext_power.h>
#include <dt-bindings/zmk/keys.h>
#include <dt-bindings/zmk/outputs.h>
#include <behaviors/num_word.dtsi> // requires auto-layer module

#include "zmk-helpers/helper.h"

#include "boards/shields/chocofi/keypos.h"
#include "layers.h"
#include "constants.h"
#include "helpers.h"
#include "combos.dtsi"

/* Global Settings */
// Multi Tap Config
&mt {
    flavor = "tap-preferred";
    tapping-term-ms = <220>;
    quick-tap-ms = <220>;              // repeat on tap-into-hold
    hold-trigger-key-positions = <0>;  // tap on interrupt
};

// sticky-key config
&sk {
    release-after-ms = <600>;  // release after 0.6s
    quick-release;             // no double capitalization when rolling keys
};

// sticky-layer config
&sl {
    ignore-modifiers;
};

// layer-tap config
&lt {
    flavor = "balanced";
    tapping-term-ms = <200>;
    quick-tap-ms = <QUICK_TAP_MS>;
};

&caps_word {  // mods deactivate caps-word, requires PR #1451
    /delete-property/ ignore-modifiers;
};


/* Upper Case mods */
#define SIMPLE_MORPH(NAME, MOD, BINDING1, BINDING2) \
    ZMK_MOD_MORPH(NAME, \
        mods = <(MOD_L ## MOD|MOD_R ## MOD)>; \
        bindings = <BINDING1>, <BINDING2>; \
    )
UC_MODMORPH(comma_semi,    &kp COMMA,                        &kp SEMICOLON)
UC_MODMORPH(dot_colon,     &kp DOT,                          &kp COLON)
UC_MODMORPH(qmark_excl,    &kp QUESTION,                     &kp EXCLAMATION)
UC_MODMORPH(squote_dquote, &kp SINGLE_QUOTE,                 &kp DOUBLE_QUOTES)
UC_MODMORPH(bksp_del,      &lt L_APP_SHORTCUTS BACKSPACE,    &kp DELETE)

/* Homerow mods */
#define HML_G(key) &hm_l LGUI key
#define HML_A(key) &hm_l LALT key
#define HML_C(key) &hm_l LCTRL key
#define HML_S(key) &hm_l LSHIFT key
MAKE_HRM(hm_l, &kp, &kp, KEYS_R THUMBS)  // left-hand HRMs

#define HMR_G(key) &hm_r LGUI key
#define HMR_A(key) &hm_r LALT key
#define HMR_C(key) &hm_r LCTRL key
#define HMR_S(key) &hm_r LSHIFT key
MAKE_HRM(hm_r, &kp, &kp, KEYS_L THUMBS)  // right-hand HRMs


/* Tap Dance Num
Tap: num-word
Hold: Num Layer
Double Tap: sticky num-layer
*/
#define num_word_dance &num_layer_word L_NUM 0
ZMK_TAP_DANCE(num_dance,
    tapping-term-ms = <TD_TAPPING_TERM>;
    bindings = <&num_word L_NUM>, <&sl L_NUM>;  // reverse this for sticky-num on single tap
)
ZMK_HOLD_TAP(num_layer_word,
    flavor = "balanced";
    tapping-term-ms = <TD_TAPPING_TERM>;
    quick-tap-ms = <QUICK_TAP_MS>;
    bindings = <&mo>, <&num_dance>;
)

/* Caps Word */
ZMK_CAPS_WORD(caps_word,
    continue-list = <
      UNDERSCORE MINUS
      LCTRL LALT LGUI LSHFT
      RCTRL RALT RGUI RSHFT
      BACKSPACE
    >;
    /delete-property/ ignore-modifiers;
)

#define CANCEL      &kp K_CANCEL             // cancel caps-word, num-word and smart-mouse
#define XXX &none
#define ___ &trans


ZMK_LAYER(base,
  //┏━━━━━━━━━━━━━━━━━┳━━━━━━━━━━━━━━━━━┳━━━━━━━━━━━━━━━━━┳━━━━━━━━━━━━━━━━━┳━━━━━━━━━━━━━━━━━┓
     &kp Q            &kp W             &kp F            &kp P             &kp B
     HML_A(A)         HML_S(R)          HML_C(S)         HML_G(T)          &kp G
     &kp Z            &kp X             &kp C            &kp D             &kp V
                                                         &kp ESC            &lt L_NAV SPACE  &lt L_APPS TAB
  //                                                      ┗━━━━━━━━━━━━━━━━━┻━━━━━━━━━━━━━━━━━┻━━━━━━━━━━━━━━━━━┛
  //                                                                      ┏━━━━━━━━━━━━━━━━━┳━━━━━━━━━━━━━━━━━┳━━━━━━━━━━━━━━━━━┳━━━━━━━━━━━━━━━━━┳━━━━━━━━━━━━━━━━━┓
                                                                           &kp J            &kp L             &kp U             &kp Y            &squote_dquote
                                                                           &kp M            HMR_G(N)          HMR_C(E)          HMR_S(I)         HMR_A(O)
                                                                           &kp K            &kp H             &comma_semi       &dot_colon       &qmark_excl
                                                          &lt L_YABAI RET  &bksp_del        num_word_dance
  //                                                      ┗━━━━━━━━━━━━━━━━━┻━━━━━━━━━━━━━━━━━┻━━━━━━━━━━━━━━━━━┛
)

ZMK_LAYER(num,
  //┏━━━━━━━━━━━━━━━━━┳━━━━━━━━━━━━━━━━━┳━━━━━━━━━━━━━━━━━┳━━━━━━━━━━━━━━━━━┳━━━━━━━━━━━━━━━━━┓
     &none            &none             &none            &none             &none
     HML_A(N6)        HML_S(N4)         HML_C(N0)        HML_G(N2)         &none
     &none            &none             &none            &kp N8            &none
                                                         CANCEL           ___              ___
  //                                                      ┗━━━━━━━━━━━━━━━━━┻━━━━━━━━━━━━━━━━━┻━━━━━━━━━━━━━━━━━┛
  //                                                                      ┏━━━━━━━━━━━━━━━━━┳━━━━━━━━━━━━━━━━━┳━━━━━━━━━━━━━━━━━┳━━━━━━━━━━━━━━━━━┳━━━━━━━━━━━━━━━━━┓
                                                                           &none            &none             &none            &none             &none
                                                                           &none            HMR_G(N3)         HMR_C(N1)        HMR_S(N5)         HMR_A(N7)
                                                                           &none            &kp N9            &none            &none             &none
                                                          ___              ___              ___
  //                                                      ┗━━━━━━━━━━━━━━━━━┻━━━━━━━━━━━━━━━━━┻━━━━━━━━━━━━━━━━━┛
)

ZMK_LAYER(num_word,
  //┏━━━━━━━━━━━━━━━━━┳━━━━━━━━━━━━━━━━━┳━━━━━━━━━━━━━━━━━┳━━━━━━━━━━━━━━━━━┳━━━━━━━━━━━━━━━━━┓
     ___               ___              ___              ___               ___
     HML_A(N6)         HML_S(N4)        HML_C(N0)        HML_G(N2)         ___
     ___               ___              ___              &kp N8            ___
                                                         CANCEL            ___              ___
  //                                                      ┗━━━━━━━━━━━━━━━━━┻━━━━━━━━━━━━━━━━━┻━━━━━━━━━━━━━━━━━┛
  //                                                                      ┏━━━━━━━━━━━━━━━━━┳━━━━━━━━━━━━━━━━━┳━━━━━━━━━━━━━━━━━┳━━━━━━━━━━━━━━━━━┳━━━━━━━━━━━━━━━━━┓
                                                                           ___              ___              ___               ___               ___
                                                                           &none            HMR_G(N3)        HMR_C(N1)         HMR_S(N5)         HMR_A(N7)
                                                                           ___              &kp N9           ___               ___               ___
                                                         ___               ___              ___
  //                                                      ┗━━━━━━━━━━━━━━━━━┻━━━━━━━━━━━━━━━━━┻━━━━━━━━━━━━━━━━━┛
)


ZMK_LAYER(nav,
  //┏━━━━━━━━━━━━━━━━━┳━━━━━━━━━━━━━━━━━┳━━━━━━━━━━━━━━━━━┳━━━━━━━━━━━━━━━━━┳━━━━━━━━━━━━━━━━━┓
     &kp LEFT_LINE    &kp PAGE_BTM      &kp PAGE_TOP     &kp RIGHT_LINE    &none
     &kp LEFT_ARROW   &kp DOWN_ARROW    &kp UP_ARROW     &kp RIGHT_ARROW   &none
     &kp LEFT_WORD    &kp PAGE_DOWN     &kp PAGE_UP      &kp RIGHT_WORD    &none
                                                         CANCEL            ___              ___
  //                                                      ┗━━━━━━━━━━━━━━━━━┻━━━━━━━━━━━━━━━━━┻━━━━━━━━━━━━━━━━━┛
  //                                                                      ┏━━━━━━━━━━━━━━━━━┳━━━━━━━━━━━━━━━━━┳━━━━━━━━━━━━━━━━━┳━━━━━━━━━━━━━━━━━┳━━━━━━━━━━━━━━━━━┓
                                                                           &none            &none            &none             &none             &none
                                                                           &none            &kp LGUI         &kp LCTRL         &kp LSHIFT        &kp LALT
                                                                           &none            &none            &none             &none             &none
                                                         ___               ___              ___
  //                                                      ┗━━━━━━━━━━━━━━━━━┻━━━━━━━━━━━━━━━━━┻━━━━━━━━━━━━━━━━━┛
)


ZMK_LAYER(nav_word,
  //┏━━━━━━━━━━━━━━━━━┳━━━━━━━━━━━━━━━━━┳━━━━━━━━━━━━━━━━━┳━━━━━━━━━━━━━━━━━┳━━━━━━━━━━━━━━━━━┓
     &kp LEFT_LINE    &kp PAGE_BTM      &kp PAGE_TOP     &kp RIGHT_LINE    ___
     &kp LEFT_ARROW   &kp DOWN_ARROW    &kp UP_ARROW     &kp RIGHT_ARROW   ___
     &kp LEFT_WORD    &kp PAGE_DOWN     &kp PAGE_UP      &kp RIGHT_WORD    ___
                                                         CANCEL            ___              ___
  //                                                      ┗━━━━━━━━━━━━━━━━━┻━━━━━━━━━━━━━━━━━┻━━━━━━━━━━━━━━━━━┛
  //                                                                      ┏━━━━━━━━━━━━━━━━━┳━━━━━━━━━━━━━━━━━┳━━━━━━━━━━━━━━━━━┳━━━━━━━━━━━━━━━━━┳━━━━━━━━━━━━━━━━━┓
                                                                           ___              ___               ___               ___              ___
                                                                           ___              ___               ___               ___              ___
                                                                           ___              ___               ___               ___              ___
                                                          ___              ___              ___
  //                                                      ┗━━━━━━━━━━━━━━━━━┻━━━━━━━━━━━━━━━━━┻━━━━━━━━━━━━━━━━━┛
)



ZMK_LAYER(fn,
  //┏━━━━━━━━━━━━━━━━━┳━━━━━━━━━━━━━━━━━┳━━━━━━━━━━━━━━━━━┳━━━━━━━━━━━━━━━━━┳━━━━━━━━━━━━━━━━━┓
     &kp F7           &kp F8            &kp F9           &kp F12           ___
     &kp F4           &kp F5            &kp F6           &kp F11           ___
     &kp F1           &kp F2            &kp F3           &kp F19           ___
                                                         CANCEL            ___              ___
  //                                                      ┗━━━━━━━━━━━━━━━━━┻━━━━━━━━━━━━━━━━━┻━━━━━━━━━━━━━━━━━┛
  //                                                                      ┏━━━━━━━━━━━━━━━━━┳━━━━━━━━━━━━━━━━━┳━━━━━━━━━━━━━━━━━┳━━━━━━━━━━━━━━━━━┳━━━━━━━━━━━━━━━━━┓
                                                                           ___              ___               ___               ___              ___
                                                                           ___              ___               ___               ___              ___
                                                                           ___              ___               ___               ___              ___
                                                          ___              ___              ___
  //                                                      ┗━━━━━━━━━━━━━━━━━┻━━━━━━━━━━━━━━━━━┻━━━━━━━━━━━━━━━━━┛
)

ZMK_LAYER(Applications,
  //┏━━━━━━━━━━━━━━━━━┳━━━━━━━━━━━━━━━━━┳━━━━━━━━━━━━━━━━━┳━━━━━━━━━━━━━━━━━┳━━━━━━━━━━━━━━━━━┓
     ITSYCAL          SPOTIFY           FORKLIFT         XXX               XXX
     NOTION           XXX               ITERM            RAYCAST           MIMESTREAM
     DISCORD          TODOIST           CHATGPT          XXX               ONEPASSWORD
                                                         CANCEL            ___              ___
  //                                                      ┗━━━━━━━━━━━━━━━━━┻━━━━━━━━━━━━━━━━━┻━━━━━━━━━━━━━━━━━┛
  //                                                                      ┏━━━━━━━━━━━━━━━━━┳━━━━━━━━━━━━━━━━━┳━━━━━━━━━━━━━━━━━┳━━━━━━━━━━━━━━━━━┳━━━━━━━━━━━━━━━━━┓
                                                                           ___              ___               ___               ___              ___
                                                                           MEDIAMATE        &kp C_NEXT        &kp C_VOL_UP      &kp C_VOL_DN     &kp C_PREV
                                                                           ___              ___               ___               ___              ___
                                                         &kp C_STOP        &kp C_PLAY_PAUSE &kp C_MUTE
  //                                                      ┗━━━━━━━━━━━━━━━━━┻━━━━━━━━━━━━━━━━━┻━━━━━━━━━━━━━━━━━┛
)



ZMK_LAYER(Yabai,
  //┏━━━━━━━━━━━━━━━━━┳━━━━━━━━━━━━━━━━━┳━━━━━━━━━━━━━━━━━┳━━━━━━━━━━━━━━━━━┳━━━━━━━━━━━━━━━━━┓
     &rb_y_q          &rb_y_w           &rb_y_f          &rb_y_p           &rb_y_b
     &rb_y_a          &rb_y_r           &rb_y_s          &rb_y_t           &rb_y_g
     &rb_y_z          &rb_y_x           &rb_y_c          &rb_y_d           &rb_y_v
                                                         CANCEL            &none            &none
  //                                                      ┗━━━━━━━━━━━━━━━━━┻━━━━━━━━━━━━━━━━━┻━━━━━━━━━━━━━━━━━┛
  //                                                                      ┏━━━━━━━━━━━━━━━━━┳━━━━━━━━━━━━━━━━━┳━━━━━━━━━━━━━━━━━┳━━━━━━━━━━━━━━━━━┳━━━━━━━━━━━━━━━━━┓
                                                                           &none            &none            &none             &none             &none
                                                                           &none            &none            &none             &none             &none
                                                                           &none            &none            &none             &none             &none
                                                        &none              &none            &none
)//                                                      ┗━━━━━━━━━━━━━━━━━┻━━━━━━━━━━━━━━━━━┻━━━━━━━━━━━━━━━━━┛
st

ZMK_LAYER(System,
  //┏━━━━━━━━━━━━━━━━━┳━━━━━━━━━━━━━━━━━┳━━━━━━━━━━━━━━━━━┳━━━━━━━━━━━━━━━━━┳━━━━━━━━━━━━━━━━━┓
     XXX              XXX               XXX               XXX              XXX
     XXX              XXX               XXX               XXX              XXX
     XXX              XXX               XXX               XXX              XXX
                                                          XXX              XXX              XXX
  //                                                      ┗━━━━━━━━━━━━━━━━━┻━━━━━━━━━━━━━━━━━┻━━━━━━━━━━━━━━━━━┛
  //                                                                      ┏━━━━━━━━━━━━━━━━━┳━━━━━━━━━━━━━━━━━┳━━━━━━━━━━━━━━━━━┳━━━━━━━━━━━━━━━━━┳━━━━━━━━━━━━━━━━━┓
                                                                           &out OUT_TOG     &bt BT_SEL 0      &bt BT_SEL 1     &bt BT_SEL 2     &bt BT_CLR
                                                                           &kp Q            XXX               XXX              XXX               XXX
                                                                           XXX              XXX               XXX              XXX               XXX
                                                          XXX              XXX              XXX
  //                                                      ┗━━━━━━━━━━━━━━━━━┻━━━━━━━━━━━━━━━━━┻━━━━━━━━━━━━━━━━━┛
)

ZMK_LAYER(AppShortcuts,
  //┏━━━━━━━━━━━━━━━━━┳━━━━━━━━━━━━━━━━━┳━━━━━━━━━━━━━━━━━┳━━━━━━━━━━━━━━━━━┳━━━━━━━━━━━━━━━━━┓
     &kp MEH(F1)       &kp MEH(F2)       &kp MEH(F3)       &kp MEH(F4)      &kp MEH(F5)
     &kp MEH(F6)       &kp MEH(F7)       &kp MEH(F8)       &kp MEH(F9)      &kp MEH(F10)
     &kp MEH(F11)      &kp MEH(F12)      &kp MEH(F13)      &kp MEH(F14)     &kp MEH(F15)
                                                         ___               ___              ___
  //                                                      ┗━━━━━━━━━━━━━━━━━┻━━━━━━━━━━━━━━━━━┻━━━━━━━━━━━━━━━━━┛
  //                                                                      ┏━━━━━━━━━━━━━━━━━┳━━━━━━━━━━━━━━━━━┳━━━━━━━━━━━━━━━━━┳━━━━━━━━━━━━━━━━━┳━━━━━━━━━━━━━━━━━┓
                                                                           &kp MEH(F16)      &kp MEH(F17)      &kp MEH(F18)      &kp MEH(F19)     &kp MEH(F20)
                                                                           &kp MEH(F11)      &kp MEH(F21)      &kp MEH(F22)      &kp MEH(F23)     &kp MEH(F24)
                                                                           &kp MEH(F11)      &kp MEH(F12)      &kp MEH(F13)      &kp MEH(F14)     &kp MEH(F15)
                                                          ___              ___              ___
  //                                                      ┗━━━━━━━━━━━━━━━━━┻━━━━━━━━━━━━━━━━━┻━━━━━━━━━━━━━━━━━┛
)
