// // use global-quick-tap-ms for combos (requires PR 1387)
// #undef COMBO_HOOK
// #define COMBO_HOOK global-quick-tap-ms = <75>;
#include "zmk-helpers/helper.h"
#include "layers.h"
#include "constants.h"

/*                                     KEY POSITIONS
    00  01  02  03  04 │ 18  19  20  21  22     LT4 LT3 LT2 LT1 LT0 │ RT0 RT1 RT2 RT3 RT4
    05  06  07  08  09 │ 23  24  25  26  27     LM4 LM3 LM2 LM1 LM0 │ RM0 RM1 RM2 RM3 RM4
    10  11  12  13  14 │ 28  29  30  31  32     LB4 LB3 LB2 LB1 LB0 │ RB0 RB1 RB2 RB3 RB4
      ─────╮ 15  16  17 │ 33  34  35 ╭─────         ─────╮ LH2 LH1 LH0 │ RH0 RH1 RH2 ╭───── 
*/

#define COMBO_GLOBAL_QUICKTAP 85

#define COMBO_TERM_FAST 18
#define COMBO_TERM_SLOW 30

#define COMBO_IDLE_FAST 150
#define COMBO_IDLE_SLOW 50

// Misc
  ZMK_COMBO(cw , &caps_word , LM1 RM1 , L_BASE L_NUM L_NUM_WORD, COMBO_TERM_SLOW, COMBO_IDLE_SLOW)

  ZMK_COMBO(system_layer , &sl L_SYSTEM     , LT0 RT0 , L_BASE                 , COMBO_TERM_SLOW, COMBO_IDLE_SLOW)
  ZMK_COMBO(fkey_layer   , &sl L_FN         , RT1 RT2 , L_BASE                 , COMBO_TERM_SLOW, COMBO_IDLE_SLOW)
  ZMK_COMBO(cut          , &kp LG       (X) , LB3 LB1 , L_BASE L_NUM L_NUM_WORD, COMBO_TERM_SLOW, COMBO_IDLE_SLOW)
  ZMK_COMBO(copy         , &kp LG       (C) , LB3 LB2 , L_BASE L_NUM L_NUM_WORD, COMBO_TERM_SLOW, COMBO_IDLE_SLOW)
  ZMK_COMBO(paste        , &kp LG       (V) , LB2 LB1 , L_BASE L_NUM L_NUM_WORD, COMBO_TERM_SLOW, COMBO_IDLE_SLOW)


// Symbols
  // Left
  ZMK_COMBO(hash  , &kp HASH              , LB1 LB0 , L_BASE L_NUM L_NUM_WORD , COMBO_TERM_FAST, COMBO_IDLE_FAST)
  ZMK_COMBO(lbkt  , &kp LEFT_BRACKET      , LT3 LT2 , L_BASE                  , COMBO_TERM_FAST, COMBO_IDLE_FAST)
  ZMK_COMBO(rbkt  , &kp RIGHT_BRACKET     , LT2 LT1 , L_BASE                  , COMBO_TERM_FAST, COMBO_IDLE_FAST)
  ZMK_COMBO(gt    , &kp LESS_THAN         , LT3 LT2 , L_NUM                   , COMBO_TERM_FAST, COMBO_IDLE_FAST)
  ZMK_COMBO(lt    , &kp GREATER_THAN      , LT2 LT1 , L_NUM                   , COMBO_TERM_FAST, COMBO_IDLE_FAST)
  ZMK_COMBO(lbrc  , &kp LEFT_BRACE        , LM3 LM2 , L_NUM                   , COMBO_TERM_FAST, COMBO_IDLE_FAST)
  ZMK_COMBO(rbrc  , &kp RIGHT_BRACE       , LM2 LM1 , L_NUM                   , COMBO_TERM_FAST, COMBO_IDLE_FAST)
  ZMK_COMBO(lpar  , &kp LEFT_PARENTHESIS  , LM3 LM2 , L_BASE                  , COMBO_TERM_FAST, COMBO_IDLE_FAST)
  ZMK_COMBO(rpar  , &kp RIGHT_PARENTHESIS , LM2 LM1 , L_BASE                  , COMBO_TERM_FAST, COMBO_IDLE_FAST)
  ZMK_COMBO(at    , &kp AT_SIGN           , LT3 LM3 , L_BASE L_NUM L_NUM_WORD , COMBO_TERM_FAST, COMBO_IDLE_FAST)
  ZMK_COMBO(grave , &kp GRAVE             , LM3 LB3 , L_BASE L_NUM L_NUM_WORD , COMBO_TERM_FAST, COMBO_IDLE_FAST)
  ZMK_COMBO(dllr  , &kp DOLLAR            , LT2 LM2 , L_BASE L_NUM L_NUM_WORD , COMBO_TERM_FAST, COMBO_IDLE_FAST)
  ZMK_COMBO(equal , &kp EQUAL             , LM2 LB2 , L_BASE L_NUM L_NUM_WORD , COMBO_TERM_FAST, COMBO_IDLE_FAST)
  ZMK_COMBO(plus  , &kp PLUS              , LT1 LM1 , L_BASE L_NUM L_NUM_WORD , COMBO_TERM_FAST, COMBO_IDLE_FAST)
  ZMK_COMBO(minus , &kp MINUS             , LM1 LB1 , L_BASE L_NUM L_NUM_WORD , COMBO_TERM_FAST, COMBO_IDLE_FAST)
  ZMK_COMBO(prcnt , &kp PERCENT           , LT0 LM0 , L_BASE L_NUM L_NUM_WORD , COMBO_TERM_FAST, COMBO_IDLE_FAST)
  ZMK_COMBO(tilde , &kp TILDE             , LM0 LB0 , L_BASE L_NUM L_NUM_WORD , COMBO_TERM_FAST, COMBO_IDLE_FAST)

  // Right
  ZMK_COMBO(amps  , &kp AMPERSAND  , RT0 RM0, L_BASE L_NUM L_NUM_WORD, COMBO_TERM_FAST, COMBO_IDLE_FAST)
  ZMK_COMBO(bslh  , &kp BACKSLASH  , RM0 RB0, L_BASE L_NUM L_NUM_WORD, COMBO_TERM_FAST, COMBO_IDLE_FAST)
  ZMK_COMBO(under , &kp UNDERSCORE , RB0 RB1, L_BASE L_NUM L_NUM_WORD, COMBO_TERM_FAST, COMBO_IDLE_FAST)
  ZMK_COMBO(astrk , &kp ASTERISK   , RT1 RM1, L_BASE L_NUM L_NUM_WORD, COMBO_TERM_FAST, COMBO_IDLE_FAST)
  ZMK_COMBO(slash , &kp SLASH      , RM1 RB1, L_BASE L_NUM L_NUM_WORD, COMBO_TERM_FAST, COMBO_IDLE_FAST)
  ZMK_COMBO(pipe  , &kp PIPE       , RT3 RM3, L_BASE L_NUM L_NUM_WORD, COMBO_TERM_FAST, COMBO_IDLE_FAST)
  ZMK_COMBO(caret , &kp CARET      , RM3 RB3, L_BASE L_NUM L_NUM_WORD, COMBO_TERM_FAST, COMBO_IDLE_FAST)



/* Recursive Bindings */
#define RECURSE_BIND(name, leader, key) \
  ZMK_MACRO(name, \
    wait-ms = <100>; \
    tap-ms = <100>; \
    bindings = <&kp MEH(leader) &kp key>; \
)

// Y
  RECURSE_BIND(rb_y_a, Y, A)
  RECURSE_BIND(rb_y_b, Y, B)
  RECURSE_BIND(rb_y_c, Y, C)
  RECURSE_BIND(rb_y_d, Y, D)
  RECURSE_BIND(rb_y_e, Y, E)
  RECURSE_BIND(rb_y_f, Y, F)
  RECURSE_BIND(rb_y_g, Y, G)
  RECURSE_BIND(rb_y_h, Y, H)
  RECURSE_BIND(rb_y_i, Y, I)
  RECURSE_BIND(rb_y_j, Y, J)
  RECURSE_BIND(rb_y_k, Y, K)
  RECURSE_BIND(rb_y_l, Y, L)
  RECURSE_BIND(rb_y_m, Y, M)
  RECURSE_BIND(rb_y_n, Y, N)
  RECURSE_BIND(rb_y_o, Y, O)
  RECURSE_BIND(rb_y_p, Y, P)
  RECURSE_BIND(rb_y_q, Y, Q)
  RECURSE_BIND(rb_y_r, Y, R)
  RECURSE_BIND(rb_y_s, Y, S)
  RECURSE_BIND(rb_y_t, Y, T)
  RECURSE_BIND(rb_y_u, Y, U)
  RECURSE_BIND(rb_y_v, Y, V)
  RECURSE_BIND(rb_y_w, Y, W)
  RECURSE_BIND(rb_y_x, Y, X)
  RECURSE_BIND(rb_y_y, Y, Y)
  RECURSE_BIND(rb_y_z, Y, Z)